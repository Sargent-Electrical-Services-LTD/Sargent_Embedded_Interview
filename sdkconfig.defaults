## sdkconfig.defaults
```kconfig
# ESP32-2432S028(R) CYD defaults for esp_bsp_generic
# Source basis: original board spec + CYD community pin mappings
# This targets the common ILI9341 + XPT2046 hardware variant.
# Note: esp_bsp_generic currently supports only I2C touch drivers, so touch is disabled here.

# Display enable
CONFIG_BSP_DISPLAY_ENABLED=y
CONFIG_BSP_DISPLAY_INTERFACE_SPI=y

# LCD SPI pins 
CONFIG_BSP_DISPLAY_SCLK_GPIO=14
CONFIG_BSP_DISPLAY_MOSI_GPIO=13
CONFIG_BSP_DISPLAY_MISO_GPIO=12
CONFIG_BSP_DISPLAY_CS_GPIO=15
CONFIG_BSP_DISPLAY_DC_GPIO=2
CONFIG_BSP_DISPLAY_RST_GPIO=-1
CONFIG_BSP_DISPLAY_BACKLIGHT_GPIO=21

# LCD driver
CONFIG_BSP_DISPLAY_DRIVER_ST7789=y
# CONFIG_BSP_DISPLAY_DRIVER_ILI9341 is not set
# CONFIG_BSP_DISPLAY_DRIVER_GC9A01 is not set

# Landscape orientation (320x240)
CONFIG_BSP_DISPLAY_ROTATION_SWAP_XY=y
# CONFIG_BSP_DISPLAY_ROTATION_MIRROR_X is not set
CONFIG_BSP_DISPLAY_ROTATION_MIRROR_Y=y

# Color order
# CONFIG_BSP_DISPLAY_COLOR_SPACE_RGB is not set
CONFIG_BSP_DISPLAY_COLOR_SPACE_BGR=y
# CONFIG_BSP_DISPLAY_INVERT_COLOR is not set
# CONFIG_BSP_DISPLAY_BRIGHTNESS_INVERT is not set

# Display timing and size
CONFIG_BSP_DISPLAY_CMD_BITS=8
CONFIG_BSP_DISPLAY_PARAM_BITS=8
CONFIG_BSP_DISPLAY_PIXEL_CLOCK=20
CONFIG_BSP_DISPLAY_WIDTH=320
CONFIG_BSP_DISPLAY_HEIGHT=240
CONFIG_BSP_DISPLAY_HORIZONTAL_OFFSET=0
CONFIG_BSP_DISPLAY_VERTICAL_OFFSET=0
CONFIG_BSP_DISPLAY_BRIGHTNESS_LEDC_CH=1
CONFIG_BSP_LCD_DRAW_BUF_HEIGHT=100
# CONFIG_BSP_LCD_DRAW_BUF_DOUBLE is not set

# Touch disabled in generic BSP (no XPT2046 driver option)
# CONFIG_BSP_TOUCH_ENABLED is not set
```
